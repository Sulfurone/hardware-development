#include "oled_ssd1306.h"
#include "app_config.h"
#include "bsp_delay.h"

static const uint8_t g_font5x7[][5] = {
    {0x00,0x00,0x00,0x00,0x00}, {0x00,0x00,0x5F,0x00,0x00},
    {0x00,0x07,0x00,0x07,0x00}, {0x14,0x7F,0x14,0x7F,0x14},
    {0x24,0x2A,0x7F,0x2A,0x12}, {0x23,0x13,0x08,0x64,0x62},
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    {0x61,0x51,0x49,0x45,0x43}
};

static void I2C_Delay(void) { Delay_Us(4); }
static void SDA_High(void) { GPIO_SetBits(OLED_SDA_PORT, OLED_SDA_PIN); }
static void SDA_Low(void) { GPIO_ResetBits(OLED_SDA_PORT, OLED_SDA_PIN); }
static void SCL_High(void) { GPIO_SetBits(OLED_SCL_PORT, OLED_SCL_PIN); }
static void SCL_Low(void) { GPIO_ResetBits(OLED_SCL_PORT, OLED_SCL_PIN); }

static void I2C_Start(void)
{
    SDA_High();
    SCL_High();
    I2C_Delay();
    SDA_Low();
    I2C_Delay();
    SCL_Low();
}

static void I2C_Stop(void)
{
    SDA_Low();
    SCL_High();
    I2C_Delay();
    SDA_High();
    I2C_Delay();
}

static void I2C_WriteByte(uint8_t data)
{
    uint8_t i;

    for (i = 0; i < 8; i++) {
        if (data & 0x80) {
            SDA_High();
        } else {
            SDA_Low();
        }
        I2C_Delay();
        SCL_High();
        I2C_Delay();
        SCL_Low();
        data <<= 1;
    }

    SDA_High();
    I2C_Delay();
    SCL_High();
    I2C_Delay();
    SCL_Low();
}

static void OLED_Write(uint8_t control, uint8_t value)
{
    I2C_Start();
    I2C_WriteByte((OLED_I2C_ADDR << 1) | 0x00);
    I2C_WriteByte(control);
    I2C_WriteByte(value);
    I2C_Stop();
}

static void OLED_Cmd(uint8_t cmd)
{
    OLED_Write(0x00, cmd);
}

static void OLED_Data(uint8_t data)
{
    OLED_Write(0x40, data);
}

static void OLED_SetPos(uint8_t x, uint8_t page)
{
    OLED_Cmd((uint8_t)(0xB0 | page));
    OLED_Cmd((uint8_t)(0x00 | (x & 0x0F)));
    OLED_Cmd((uint8_t)(0x10 | (x >> 4)));
}

void OLED_Clear(void)
{
    uint8_t page;
    uint8_t x;

    for (page = 0; page < OLED_PAGES; page++) {
        OLED_SetPos(0, page);
        for (x = 0; x < OLED_WIDTH; x++) {
            OLED_Data(0x00);
        }
    }
}

static void OLED_Char(uint8_t x, uint8_t page, char ch)
{
    uint8_t i;
    const uint8_t *bitmap;

    if (ch >= 'a' && ch <= 'z') {
        ch = (char)(ch - 'a' + 'A');
    }
    if (ch < ' ' || ch > 'Z') {
        ch = ' ';
    }

    bitmap = g_font5x7[ch - ' '];
    OLED_SetPos(x, page);
    for (i = 0; i < 5; i++) {
        OLED_Data(bitmap[i]);
    }
    OLED_Data(0x00);
}

void OLED_Text(uint8_t x, uint8_t page, const char *text)
{
    while (*text && x < (OLED_WIDTH - 5)) {
        OLED_Char(x, page, *text++);
        x = (uint8_t)(x + 6);
    }
}

void OLED_Init(void)
{
    GPIO_InitTypeDef gpio;

    gpio.GPIO_Pin = OLED_SCL_PIN | OLED_SDA_PIN;
    gpio.GPIO_Mode = GPIO_Mode_Out_OD;
    gpio.GPIO_Speed = GPIO_Speed_50MHz;
    GPIO_Init(GPIOB, &gpio);

    SDA_High();
    SCL_High();
    Delay_Ms(100);

    OLED_Cmd(0xAE);
    OLED_Cmd(0x20);
    OLED_Cmd(0x02);
    OLED_Cmd(0xB0);
    OLED_Cmd(0xC8);
    OLED_Cmd(0x00);
    OLED_Cmd(0x10);
    OLED_Cmd(0x40);
    OLED_Cmd(0x81);
    OLED_Cmd(0x7F);
    OLED_Cmd(0xA1);
    OLED_Cmd(0xA6);
    OLED_Cmd(0xA8);
    OLED_Cmd(0x3F);
    OLED_Cmd(0xA4);
    OLED_Cmd(0xD3);
    OLED_Cmd(0x00);
    OLED_Cmd(0xD5);
    OLED_Cmd(0x80);
    OLED_Cmd(0xD9);
    OLED_Cmd(0xF1);
    OLED_Cmd(0xDA);
    OLED_Cmd(0x12);
    OLED_Cmd(0xDB);
    OLED_Cmd(0x40);
    OLED_Cmd(0x8D);
    OLED_Cmd(0x14);
    OLED_Cmd(0xAF);
    OLED_Clear();
}
